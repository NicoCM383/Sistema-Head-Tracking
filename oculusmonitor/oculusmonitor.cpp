#define NOMINMAX  
#include "imgui.h"
#include "imgui_impl_win32.h"
#include "imgui_impl_dx11.h"
#include <d3d11.h>
#define DIRECTINPUT_VERSION 0x0800
#include <dinput.h>
#include <tchar.h>
#include <iostream>
#include "OVR_Platform.h"
#include "OVR_CAPI.h"
#include "Extras/OVR_Math.h"
#include <vector>
#include <algorithm>
#include "kf/kf_time.h"
#include <fstream>
#include "vrstate.h"
#include "aabb.h"
#include <cmath>
#include <cstdint>
#include <iomanip>
#include <sstream>
#include <string>
#include <windows.h>


class SerialPort {
public:
	SerialPort() : handle_(INVALID_HANDLE_VALUE), connected_(false) {}

	~SerialPort() {
		close();
	}

	bool open(const std::string& portName, DWORD baudRate = CBR_115200) {
		close();

		std::string fullPortName = portName;
		if (portName.rfind("\\\\.\\", 0) != 0) {
			fullPortName = "\\\\.\\" + portName;
		}

		handle_ = CreateFileA(
			fullPortName.c_str(),
			GENERIC_READ | GENERIC_WRITE,
			0,
			nullptr,
			OPEN_EXISTING,
			0,
			nullptr
		);

		if (handle_ == INVALID_HANDLE_VALUE) {
			connected_ = false;
			return false;
		}

		DCB dcbSerialParams = {};
		dcbSerialParams.DCBlength = sizeof(dcbSerialParams);

		if (!GetCommState(handle_, &dcbSerialParams)) {
			close();
			return false;
		}

		dcbSerialParams.BaudRate = baudRate;
		dcbSerialParams.ByteSize = 8;
		dcbSerialParams.StopBits = ONESTOPBIT;
		dcbSerialParams.Parity = NOPARITY;
		dcbSerialParams.fDtrControl = DTR_CONTROL_ENABLE;

		if (!SetCommState(handle_, &dcbSerialParams)) {
			close();
			return false;
		}

		COMMTIMEOUTS timeouts = {};
		timeouts.ReadIntervalTimeout = 50;
		timeouts.ReadTotalTimeoutConstant = 50;
		timeouts.ReadTotalTimeoutMultiplier = 10;
		timeouts.WriteTotalTimeoutConstant = 50;
		timeouts.WriteTotalTimeoutMultiplier = 10;

		if (!SetCommTimeouts(handle_, &timeouts)) {
			close();
			return false;
		}

		// Purgar basura acumulada mientras el baudrate estaba mal
		PurgeComm(handle_, PURGE_RXCLEAR | PURGE_TXCLEAR);

		// El Mega se resetea al abrir el puerto (DTR). Esperar al bootloader.
		Sleep(2000);

		PurgeComm(handle_, PURGE_RXCLEAR);

		connected_ = true;
		return true;
	}

	void close() {
		if (handle_ != INVALID_HANDLE_VALUE) {
			CloseHandle(handle_);
			handle_ = INVALID_HANDLE_VALUE;
		}
		connected_ = false;
	}

	bool isConnected() const {
		return connected_;
	}

	int writeFails_ = 0;
	long long totalBytesWritten_ = 0;

	bool writeBytes(const uint8_t* data, size_t length) {
		if (!connected_ || handle_ == INVALID_HANDLE_VALUE) {
			return false;
		}

		DWORD bytesWritten = 0;
		if (!WriteFile(handle_, data, static_cast<DWORD>(length), &bytesWritten, nullptr)) {
			writeFails_++;
			lastError_ = GetLastError();
			connected_ = false;
			return false;
		}

		totalBytesWritten_ += bytesWritten;
		return bytesWritten == length;
	}

	// Diagnostico: campos publicos para ver que pasa
	DWORD lastError_ = 0;
	DWORD lastInQueue_ = 0;
	int clearCommErrorFails_ = 0;
	int readFileFails_ = 0;
	long long totalBytesRead_ = 0;

	// Lee lo que haya disponible sin bloquear. Devuelve cuantos bytes leyo.
	size_t readBytes(uint8_t* buffer, size_t maxLength) {
		if (!connected_ || handle_ == INVALID_HANDLE_VALUE) {
			return 0;
		}

		COMSTAT status = {};
		DWORD errors = 0;
		if (!ClearCommError(handle_, &errors, &status)) {
			clearCommErrorFails_++;
			lastError_ = GetLastError();
			return 0;
		}

		lastInQueue_ = status.cbInQue;

		if (status.cbInQue == 0) {
			return 0;
		}

		DWORD toRead = status.cbInQue;
		if (static_cast<size_t>(toRead) > maxLength) {
			toRead = static_cast<DWORD>(maxLength);
		}

		DWORD bytesRead = 0;
		if (!ReadFile(handle_, buffer, toRead, &bytesRead, nullptr)) {
			readFileFails_++;
			lastError_ = GetLastError();
			return 0;
		}

		totalBytesRead_ += bytesRead;
		return static_cast<size_t>(bytesRead);
	}

private:
	HANDLE handle_;
	bool connected_;
};

extern "C" {
#include "mavlink/common/mavlink.h"
}

struct EulerAngles {
	float roll, pitch, yaw;
};

struct MavlinkPacket {
	uint8_t buffer[MAVLINK_MAX_PACKET_LEN]{};
	uint16_t length = 0;
};

class ScalarKalmanFilter {
public:
	ScalarKalmanFilter(float processNoise = 0.01f,
		float measurementNoise = 0.5f,
		float estimationError = 1.0f)
		: q_(processNoise),
		r_(measurementNoise),
		p_(estimationError),
		x_(0.0f),
		initialized_(false) {
	}

	float update(float measurement) {
		if (!initialized_) {
			x_ = measurement;
			initialized_ = true;
			return x_;
		}

		p_ += q_;
		const float k = p_ / (p_ + r_);
		x_ = x_ + k * (measurement - x_);
		p_ = (1.0f - k) * p_;
		return x_;
	}

	void reset() {
		p_ = 1.0f;
		x_ = 0.0f;
		initialized_ = false;
	}

private:
	float q_;
	float r_;
	float p_;
	float x_;
	bool initialized_;
};

constexpr float PI_F = 3.14159265359f;
constexpr float DEG2RAD = PI_F / 180.0f;

float NormalizeAngleDeg(float angle) {
	while (angle > 180.0f) angle -= 360.0f;
	while (angle < -180.0f) angle += 360.0f;
	return angle;
}

float UnwrapAngleDeg(float currentAngle, float previousContinuousAngle) {
	float delta = currentAngle - previousContinuousAngle;

	while (delta > 180.0f) delta -= 360.0f;
	while (delta < -180.0f) delta += 360.0f;

	return previousContinuousAngle + delta;
}

EulerAngles NormalizeEuler(const EulerAngles& angles) {
	EulerAngles out = angles;
	out.roll = NormalizeAngleDeg(out.roll);
	out.pitch = NormalizeAngleDeg(out.pitch);
	out.yaw = NormalizeAngleDeg(out.yaw);
	return out;
}

std::string BytesToHex(const uint8_t* data, uint16_t length) {
	std::ostringstream oss;
	oss << std::hex << std::uppercase << std::setfill('0');

	for (uint16_t i = 0; i < length; ++i) {
		oss << std::setw(2) << static_cast<int>(data[i]);
		if (i + 1 < length) {
			oss << ' ';
		}
	}

	return oss.str();
}

MavlinkPacket BuildAttitudePacket(const EulerAngles& anglesDeg, uint32_t timeBootMs) {
	constexpr uint8_t SYSTEM_ID = 1;
	constexpr uint8_t COMPONENT_ID = 200;

	mavlink_message_t msg{};
	MavlinkPacket packet{};

	mavlink_msg_attitude_pack(
		SYSTEM_ID,
		COMPONENT_ID,
		&msg,
		timeBootMs,
		anglesDeg.roll * DEG2RAD,
		anglesDeg.pitch * DEG2RAD,
		anglesDeg.yaw * DEG2RAD,
		0.0f, 0.0f, 0.0f
	);

	packet.length = mavlink_msg_to_send_buffer(packet.buffer, &msg);
	return packet;
}

EulerAngles ToEulerAngles(const ovrQuatf& q) {
	constexpr float PI = 3.14159265359f;
	EulerAngles angles;
	constexpr float RAD2DEG = 180.0f / static_cast<float>(PI);

	float sinr_cosp = 2.0f * (q.w * q.x + q.y * q.z);
	float cosr_cosp = 1.0f - 2.0f * (q.x * q.x + q.y * q.y);
	angles.roll = std::atan2(sinr_cosp, cosr_cosp) * RAD2DEG;

	float sinp = 2.0f * (q.w * q.y - q.z * q.x);
	if (std::abs(sinp) >= 1.0f)
		angles.pitch = std::copysign(90.0f, sinp);
	else
		angles.pitch = std::asin(sinp) * RAD2DEG;

	float siny_cosp = 2.0f * (q.w * q.z + q.x * q.y);
	float cosy_cosp = 1.0f - 2.0f * (q.y * q.y + q.z * q.z);
	angles.yaw = std::atan2(siny_cosp, cosy_cosp) * RAD2DEG;

	auto normalizeDeg = [](float angle) {
		while (angle > 180.0f) angle -= 360.0f;
		while (angle < -180.0f) angle += 360.0f;
		return angle;
		};

	angles.roll = normalizeDeg(angles.roll);
	angles.pitch = normalizeDeg(angles.pitch);
	angles.yaw = normalizeDeg(angles.yaw);

	return angles;
}


#pragma comment(lib,"LibOVR.lib")

static ID3D11Device* g_pd3dDevice = NULL;
static ID3D11DeviceContext* g_pd3dDeviceContext = NULL;
static IDXGISwapChain* g_pSwapChain = NULL;
static ID3D11RenderTargetView* g_mainRenderTargetView = NULL;
ovrSession						g_HMD = 0;
bool							g_minimised = false;

void CreateRenderTarget()
{
	ID3D11Texture2D* pBackBuffer;
	g_pSwapChain->GetBuffer(0, __uuidof(ID3D11Texture2D), (LPVOID*)&pBackBuffer);
	g_pd3dDevice->CreateRenderTargetView(pBackBuffer, NULL, &g_mainRenderTargetView);
	pBackBuffer->Release();
}

void CleanupRenderTarget()
{
	if (g_mainRenderTargetView) { g_mainRenderTargetView->Release(); g_mainRenderTargetView = NULL; }
}

HRESULT CreateDeviceD3D(HWND hWnd)
{
	// Setup swap chain
	DXGI_SWAP_CHAIN_DESC sd;
	ZeroMemory(&sd, sizeof(sd));
	sd.BufferCount = 2;
	sd.BufferDesc.Width = 0;
	sd.BufferDesc.Height = 0;
	sd.BufferDesc.Format = DXGI_FORMAT_R8G8B8A8_UNORM;
	sd.BufferDesc.RefreshRate.Numerator = 90;
	sd.BufferDesc.RefreshRate.Denominator = 1;
	sd.Flags = DXGI_SWAP_CHAIN_FLAG_ALLOW_MODE_SWITCH;
	sd.BufferUsage = DXGI_USAGE_RENDER_TARGET_OUTPUT;
	sd.OutputWindow = hWnd;
	sd.SampleDesc.Count = 1;
	sd.SampleDesc.Quality = 0;
	sd.Windowed = TRUE;
	sd.SwapEffect = DXGI_SWAP_EFFECT_DISCARD;

	UINT createDeviceFlags = 0;
	D3D_FEATURE_LEVEL featureLevel;
	const D3D_FEATURE_LEVEL featureLevelArray[2] = { D3D_FEATURE_LEVEL_11_0, D3D_FEATURE_LEVEL_10_0, };
	if (D3D11CreateDeviceAndSwapChain(NULL, D3D_DRIVER_TYPE_HARDWARE, NULL, createDeviceFlags, featureLevelArray, 2, D3D11_SDK_VERSION, &sd, &g_pSwapChain, &g_pd3dDevice, &featureLevel, &g_pd3dDeviceContext) != S_OK)
		return E_FAIL;

	CreateRenderTarget();

	return S_OK;
}

void CleanupDeviceD3D()
{
	CleanupRenderTarget();
	if (g_pSwapChain) { g_pSwapChain->Release(); g_pSwapChain = NULL; }
	if (g_pd3dDeviceContext) { g_pd3dDeviceContext->Release(); g_pd3dDeviceContext = NULL; }
	if (g_pd3dDevice) { g_pd3dDevice->Release(); g_pd3dDevice = NULL; }
}

extern LRESULT ImGui_ImplWin32_WndProcHandler(HWND hWnd, UINT msg, WPARAM wParam, LPARAM lParam);
LRESULT WINAPI WndProc(HWND hWnd, UINT msg, WPARAM wParam, LPARAM lParam)
{
	if (ImGui_ImplWin32_WndProcHandler(hWnd, msg, wParam, lParam))
		return true;
	std::cout << msg << std::endl;
	switch (msg)
	{
	case WM_PAINT:
		g_minimised = false;
		break;
	case WM_SIZE:
		if (wParam == SIZE_MINIMIZED)
		{
			g_minimised = true;
		}
		else
		{
			if (g_pd3dDevice != NULL)
			{
				ImGui_ImplDX11_InvalidateDeviceObjects();
				CleanupRenderTarget();
				g_pSwapChain->ResizeBuffers(0, (UINT)LOWORD(lParam), (UINT)HIWORD(lParam), DXGI_FORMAT_UNKNOWN, 0);
				CreateRenderTarget();
				ImGui_ImplDX11_CreateDeviceObjects();
			}
		}
		if (wParam == SIZE_RESTORED)
		{
			g_minimised = false;
		}
		return 0;
	case WM_SYSCOMMAND:
		if ((wParam & 0xfff0) == SC_KEYMENU)
			return 0;
		break;
	case WM_DESTROY:
		PostQuitMessage(0);
		return 0;
	}
	return DefWindowProc(hWnd, msg, wParam, lParam);
}

void appendstring(std::string& s, const std::string& a)
{
	if (s != "")
	{
		s += ", ";
	}
	s += a;
}


int WinMain(HINSTANCE hInstance, HINSTANCE hPrevInstance, LPSTR lpCmdLine, int nCmdShow)
{
	WNDCLASSEX wc = { sizeof(WNDCLASSEX), CS_CLASSDC, WndProc, 0L, 0L, GetModuleHandle(NULL), NULL, NULL, NULL, NULL, _T("Oculus Monitor"), NULL };
	RegisterClassEx(&wc);
	HWND hwnd = CreateWindow(_T("Oculus Monitor"), _T("Oculus Monitor"), WS_OVERLAPPEDWINDOW, 100, 100, 1280, 800, NULL, NULL, wc.hInstance, NULL);
	StateManager stateManager;
	float currentTime = 0;
	kf::Time timer;
	bool paused = false;

	if (CreateDeviceD3D(hwnd) < 0)
	{
		CleanupDeviceD3D();
		UnregisterClass(_T("Oculus Monitor"), wc.hInstance);
		return 1;
	}

	ShowWindow(hwnd, SW_SHOWDEFAULT);
	UpdateWindow(hwnd);

	IMGUI_CHECKVERSION();
	ImGui::CreateContext();
	ImGuiIO& io = ImGui::GetIO(); (void)io;

	ImGui_ImplWin32_Init(hwnd);
	ImGui_ImplDX11_Init(g_pd3dDevice, g_pd3dDeviceContext);

	ImGui::StyleColorsDark();

	ImVec4 clear_color = ImVec4(0.45f, 0.55f, 0.60f, 1.00f);
	bool showSerial = false;
	int currentHudMode = 0;
	bool showSensors = true;
	float pixelDensity = 1.0f;
	bool trackingFloorLevel = true;

	SerialPort serialPort;
	char serialPortName[32] = "COM5";   // Cambialo por el puerto real del Arduino
	int serialBaudRate = 115200;

	bool useKalman = true;
	bool showMavlinkPacket = true;
	uint32_t mavTimeMs = 0;

	// Log de lo que el Arduino manda de vuelta por el mismo puerto
	std::string arduinoLog;
	bool showArduinoLog = true;
	constexpr size_t ARDUINO_LOG_MAX = 4000;

	ScalarKalmanFilter rollKalman(0.01f, 0.5f, 1.0f);
	ScalarKalmanFilter pitchKalman(0.01f, 0.5f, 1.0f);
	ScalarKalmanFilter yawKalman(0.01f, 0.5f, 1.0f);

	bool angleStreamInitialized = false;
	EulerAngles previousContinuousAngles{ 0.0f, 0.0f, 0.0f };

	ovrGraphicsLuid g_luid;
	ovrInitParams params;
	params.Flags = ovrInit_Invisible;
	params.ConnectionTimeoutMS = 0;
	params.RequestedMinorVersion = 26;
	params.UserData = 0;
	params.LogCallback = 0;

	ovrResult result = ovr_Initialize(&params);
	if (OVR_FAILURE(result))
		return 1;

	result = ovr_Create(&g_HMD, &g_luid);
	if (OVR_FAILURE(result) || !g_HMD)
		return 1;

	ovr_SetTrackingOriginType(g_HMD, ovrTrackingOrigin::ovrTrackingOrigin_FloorLevel);

	currentHudMode = ovr_GetInt(g_HMD, OVR_PERF_HUD_MODE, 0);

	MSG msg;
	ZeroMemory(&msg, sizeof(msg));
	while (msg.message != WM_QUIT)
	{
		if (PeekMessage(&msg, NULL, 0U, 0U, PM_REMOVE))
		{
			TranslateMessage(&msg);
			DispatchMessage(&msg);
			continue;
		}

		double deltaT = timer.deltaTime();

		if (deltaT > 0.0) {
			mavTimeMs += static_cast<uint32_t>(deltaT * 1000.0);
		}

		if (!IsIconic(hwnd))
		{
			ImGui_ImplDX11_NewFrame();
			ImGui_ImplWin32_NewFrame();
			ImGui::NewFrame();

			if (g_HMD)
			{
				VRState state = stateManager.poll(g_HMD, currentTime);

				{
					ImGui::Begin("Playback");
					if (stateManager.m_pollState == StateManager::e_record)
					{
						ImGui::PushStyleColor(ImGuiCol_Button, 0xffff0000);
						if (ImGui::Button("Record"))
						{
							stateManager.m_pollState = StateManager::e_live;
						}
						ImGui::PopStyleColor();
					}
					else
					{
						if (ImGui::Button("Record"))
						{
							stateManager.reset();
							stateManager.m_pollState = StateManager::e_record;
							currentTime = 0;
						}
					}
					ImGui::SameLine();
					if (stateManager.m_pollState == StateManager::e_playback)
					{
						ImGui::PushStyleColor(ImGuiCol_Button, 0xffff0000);
						if (ImGui::Button("Play"))
						{
							stateManager.m_pollState = StateManager::e_live;
						}
						ImGui::PopStyleColor();
					}
					else
					{
						if (ImGui::Button("Play"))
						{
							currentTime = 0;
							stateManager.m_pollState = StateManager::e_playback;
						}
					}

					ImGui::SameLine();
					if (ImGui::Button("Stop"))
					{
						stateManager.m_pollState = StateManager::e_live;
					}

					ImGui::SameLine();
					if (paused)
					{
						ImGui::PushStyleColor(ImGuiCol_Button, 0xffff0000);
						if (ImGui::Button("Pause"))
						{
							paused = false;
						}
						ImGui::PopStyleColor();
					}
					else
					{
						if (ImGui::Button("Pause"))
						{
							paused = true;
						}
					}
					if (!stateManager.m_samples.empty())
					{
						if (ImGui::Button("Export CSV"))
						{
							char filename[MAX_PATH];

							OPENFILENAME ofn;
							ZeroMemory(&filename, sizeof(filename));
							ZeroMemory(&ofn, sizeof(ofn));
							ofn.lStructSize = sizeof(ofn);
							ofn.hwndOwner = hwnd;
							ofn.lpstrFilter = "CSV Files\0*.csv\0Any File\0*.*\0";
							ofn.lpstrFile = filename;
							ofn.nMaxFile = MAX_PATH;
							ofn.lpstrTitle = "Select destination for export";
							ofn.Flags = OFN_NOCHANGEDIR;

							if (GetSaveFileNameA(&ofn))
							{
								stateManager.exportCSV(filename);
							}
						}
						if (ImGui::Button("Export DAE"))
						{
							char filename[MAX_PATH];

							OPENFILENAME ofn;
							ZeroMemory(&filename, sizeof(filename));
							ZeroMemory(&ofn, sizeof(ofn));
							ofn.lStructSize = sizeof(ofn);
							ofn.hwndOwner = hwnd;
							ofn.lpstrFilter = "DAE Files\0*.dae\0Any File\0*.*\0";
							ofn.lpstrFile = filename;
							ofn.nMaxFile = MAX_PATH;
							ofn.lpstrTitle = "Select destination for export";
							ofn.Flags = OFN_NOCHANGEDIR;

							if (GetSaveFileNameA(&ofn))
							{
								stateManager.exportDAE(g_HMD, filename);
							}
						}
					}


					switch (stateManager.m_pollState)
					{
					case StateManager::e_playback:
						ImGui::LabelText("Mode", "Playback");
						if (!paused)
							currentTime += deltaT;
						break;
					case StateManager::e_record:
						ImGui::LabelText("Mode", "Recording");
						if (!paused)
							currentTime += deltaT;
						break;
					case StateManager::e_live:
						ImGui::LabelText("Mode", "Live");
						break;
					}

					if (!stateManager.m_samples.empty())
					{
						ImGui::LabelText("Recorded", "%0.2fs", stateManager.m_samples.back().time);
						if (stateManager.m_pollState != StateManager::e_record)
						{
							if (currentTime > stateManager.m_samples.back().time)
								currentTime = stateManager.m_samples.back().time;
							ImGui::SliderFloat("Time", &currentTime, 0, stateManager.m_samples.back().time);
						}
					}
					ImGui::End();
				}

				{

					auto hmddesc = ovr_GetHmdDesc(g_HMD);
					OVR::Quatf q = state.trackingState.HeadPose.ThePose.Orientation;

					ImGui::SetNextWindowSize(ImVec2(600, 0), ImGuiCond_Always);
					ImGui::PushStyleVar(ImGuiStyleVar_WindowPadding, ImVec2(15, 15));
					ImGui::PushStyleVar(ImGuiStyleVar_FramePadding, ImVec2(10, 6));

					ImGui::Begin("Headset");

					ImGui::Text("Oculus Headset Info");
					ImGui::Separator();
					ImGui::Dummy(ImVec2(0.0f, 5.0f));

					ImGui::Checkbox("Show Serial", &showSerial);
					if (showSerial)
						ImGui::Text("Serial: %s", hmddesc.SerialNumber);

					ImGui::Separator();
					ImGui::Text("Arduino Serial Output");

					ImGui::InputText("COM Port", serialPortName, IM_ARRAYSIZE(serialPortName));
					ImGui::InputInt("Baud Rate", &serialBaudRate);

					if (!serialPort.isConnected()) {
						if (ImGui::Button("Connect Arduino")) {
							serialPort.open(serialPortName, static_cast<DWORD>(serialBaudRate));
							arduinoLog.clear();
						}
					}
					else {
						ImGui::TextColored(ImVec4(0, 1, 0, 1), "Connected to %s", serialPortName);
						if (ImGui::Button("Disconnect Arduino")) {
							serialPort.close();
						}
					}

					ImGui::Columns(2, nullptr, false);
					ImGui::Text("Manufacturer"); ImGui::NextColumn(); ImGui::Text("%s", hmddesc.Manufacturer); ImGui::NextColumn();
					ImGui::Text("Firmware");     ImGui::NextColumn(); ImGui::Text("%d.%d", hmddesc.FirmwareMajor, hmddesc.FirmwareMinor); ImGui::NextColumn();
					ImGui::Text("Product");      ImGui::NextColumn(); ImGui::Text("%s", hmddesc.ProductName); ImGui::NextColumn();
					ImGui::Columns(1);

					if (hmddesc.AvailableHmdCaps & ovrHmdCap_DebugDevice)
						ImGui::TextColored(ImVec4(1, 0.5f, 0.5f, 1), "Headset is a virtual debug device");

					ImGui::Dummy(ImVec2(0.0f, 5.0f));
					ImGui::Separator();
					ImGui::Text("Tracking Capabilities");

					std::string caps;
					if (hmddesc.AvailableTrackingCaps & ovrTrackingCap_Orientation) appendstring(caps, "Orientation");
					if (hmddesc.AvailableTrackingCaps & ovrTrackingCap_MagYawCorrection) appendstring(caps, "Mag Yaw Correction");
					if (hmddesc.AvailableTrackingCaps & ovrTrackingCap_Position) appendstring(caps, "Position");
					ImGui::Text("Caps: %s", caps.c_str());

					std::string tracking;
					if (state.trackingState.StatusFlags & ovrStatus_OrientationTracked) appendstring(tracking, "Orientation");
					if (state.trackingState.StatusFlags & ovrStatus_PositionTracked) appendstring(tracking, "Position");

					ImGui::AlignTextToFramePadding();
					ImGui::Text("Floor level tracking");
					ImGui::SameLine();
					ImGui::Checkbox("##FloorTracking", &trackingFloorLevel);
					if (ImGui::IsItemDeactivatedAfterEdit()) {
						ovr_SetTrackingOriginType(g_HMD, trackingFloorLevel ? ovrTrackingOrigin_FloorLevel : ovrTrackingOrigin_EyeLevel);
					}
					ImGui::Text("Tracking: %s", tracking.c_str());

					ImGui::Dummy(ImVec2(0.0f, 5.0f));
					ImGui::Separator();
					ImGui::Text("Pose & Motion");

					ImGui::Text("Position: %.2f, %.2f, %.2f",
						state.trackingState.HeadPose.ThePose.Position.x,
						state.trackingState.HeadPose.ThePose.Position.y,
						state.trackingState.HeadPose.ThePose.Position.z);

					ImGui::Text("Orientation (Quat): w: %.2f, x: %.2f, y: %.2f, z: %.2f",
						q.w, q.x, q.y, q.z);

					ImGui::Text("BUILD V3");

					constexpr float SIGN_ROLL = -1.0f;
					constexpr float SIGN_PITCH = +1.0f;
					constexpr float SIGN_YAW = -1.0f;

					float yawRad, pitchRad, rollRad;
					q.GetEulerAngles<OVR::Axis_Y, OVR::Axis_X, OVR::Axis_Z>(&yawRad, &pitchRad, &rollRad);

					constexpr float RAD2DEG_F = 180.0f / PI_F;

					EulerAngles rawAngles;
					rawAngles.yaw = SIGN_YAW * yawRad * RAD2DEG_F;
					rawAngles.pitch = SIGN_PITCH * pitchRad * RAD2DEG_F;
					rawAngles.roll = SIGN_ROLL * rollRad * RAD2DEG_F;

					if (!angleStreamInitialized) {
						previousContinuousAngles = rawAngles;
						angleStreamInitialized = true;
					}

					EulerAngles continuousAngles;
					continuousAngles.roll = UnwrapAngleDeg(rawAngles.roll, previousContinuousAngles.roll);
					continuousAngles.pitch = UnwrapAngleDeg(rawAngles.pitch, previousContinuousAngles.pitch);
					continuousAngles.yaw = UnwrapAngleDeg(rawAngles.yaw, previousContinuousAngles.yaw);

					previousContinuousAngles = continuousAngles;

					EulerAngles filteredAngles = continuousAngles;

					if (useKalman) {
						filteredAngles.roll = rollKalman.update(continuousAngles.roll);
						filteredAngles.pitch = pitchKalman.update(continuousAngles.pitch);
						filteredAngles.yaw = yawKalman.update(continuousAngles.yaw);
					}

					EulerAngles outputAngles = NormalizeEuler(filteredAngles);

					MavlinkPacket attitudePacket = BuildAttitudePacket(outputAngles, mavTimeMs);

					if (serialPort.isConnected()) {
						serialPort.writeBytes(attitudePacket.buffer, attitudePacket.length);

						// Leer lo que el Arduino haya mandado de vuelta (debug)
						uint8_t rxBuffer[256];
						size_t rxCount = serialPort.readBytes(rxBuffer, sizeof(rxBuffer));
						if (rxCount > 0) {
							arduinoLog.append(reinterpret_cast<char*>(rxBuffer), rxCount);

							if (arduinoLog.size() > ARDUINO_LOG_MAX) {
								arduinoLog.erase(0, arduinoLog.size() - ARDUINO_LOG_MAX);
							}
						}
					}

					std::string mavHex = BytesToHex(attitudePacket.buffer, attitudePacket.length);


					bool kalmanChanged = ImGui::Checkbox("Use Kalman", &useKalman);
					if (kalmanChanged) {
						rollKalman.reset();
						pitchKalman.reset();
						yawKalman.reset();
						angleStreamInitialized = false;
					}

					ImGui::SameLine();
					ImGui::Checkbox("Show MAVLink Packet", &showMavlinkPacket);

					ImGui::Text("Orientation Raw (YPR): Yaw: %.2f, Pitch: %.2f, Roll: %.2f",
						rawAngles.yaw, rawAngles.pitch, rawAngles.roll);

					ImGui::Text("Orientation Filtered (YPR): Yaw: %.2f, Pitch: %.2f, Roll: %.2f",
						outputAngles.yaw, outputAngles.pitch, outputAngles.roll);

					if (showMavlinkPacket) {
						ImGui::Text("MAVLink Msg ID: %d", MAVLINK_MSG_ID_ATTITUDE);
						ImGui::Text("MAVLink Packet Length: %u bytes", attitudePacket.length);
						ImGui::TextWrapped("MAVLink Packet: %s", mavHex.c_str());
					}

					ImGui::Separator();
					ImGui::Checkbox("Show Arduino Log", &showArduinoLog);

					if (showArduinoLog) {
						ImGui::SameLine();
						if (ImGui::Button("Clear Log")) {
							arduinoLog.clear();
						}

						ImGui::BeginChild("ArduinoLog", ImVec2(0, 150), true,
							ImGuiWindowFlags_HorizontalScrollbar);
						ImGui::TextUnformatted(arduinoLog.c_str());
						ImGui::SetScrollY(ImGui::GetScrollMaxY());
						ImGui::EndChild();
					}

					ImGui::Text("TX: total=%lld  fails=%d   |   RX: total=%lld  inQueue=%lu  CCEfail=%d  RFfail=%d  lastErr=%lu",
						serialPort.totalBytesWritten_,
						serialPort.writeFails_,
						serialPort.totalBytesRead_,
						serialPort.lastInQueue_,
						serialPort.clearCommErrorFails_,
						serialPort.readFileFails_,
						serialPort.lastError_);

					ImGui::Text("Velocity: %.2f, %.2f, %.2f",
						state.trackingState.HeadPose.LinearVelocity.x,
						state.trackingState.HeadPose.LinearVelocity.y,
						state.trackingState.HeadPose.LinearVelocity.z);

					ImGui::Dummy(ImVec2(0.0f, 5.0f));
					ImGui::Separator();
					ImGui::Text("Display & Rendering");

					ImGui::Text("Panel Resolution: %d x %d", hmddesc.Resolution.w, hmddesc.Resolution.h);
					ImGui::Text("Runtime Version: %s", ovr_GetVersionString());

					const char* hudModes[] = {
						"None", "PerfSummary", "LatencyTiming", "AppRenderTiming",
						"CompRenderTiming", "VersionInfo", "AswStats"
					};

					if (ImGui::Combo("Hud Mode", &currentHudMode, hudModes, IM_ARRAYSIZE(hudModes))) {
						ovr_SetInt(g_HMD, OVR_PERF_HUD_MODE, currentHudMode);
					}

					ImGui::SliderFloat("Pixel Density", &pixelDensity, 0.1f, 5.0f);

					ovrSizei texSize = ovr_GetFovTextureSize(g_HMD, ovrEye_Left, hmddesc.DefaultEyeFov[0], pixelDensity);
					ImGui::Text("Render Resolution: %d x %d (%.2f MP)", texSize.w, texSize.h, (texSize.w* texSize.h) / 1e6f);

					ImGui::End();
					ImGui::PopStyleVar(2);


				}

				{
					ImGui::Begin("Controllers");
					unsigned int connected = ovr_GetConnectedControllerTypes(g_HMD);
					bool conn_left = connected & ovrControllerType::ovrControllerType_LTouch;
					bool conn_right = connected & ovrControllerType::ovrControllerType_RTouch;
					bool conn_remote = connected & ovrControllerType::ovrControllerType_Remote;
					bool conn_xbox = connected & ovrControllerType::ovrControllerType_XBox;
					bool conn_object0 = connected & ovrControllerType::ovrControllerType_Object0;
					bool conn_object1 = connected & ovrControllerType::ovrControllerType_Object1;
					bool conn_object2 = connected & ovrControllerType::ovrControllerType_Object2;
					bool conn_object3 = connected & ovrControllerType::ovrControllerType_Object3;

					ImGui::Checkbox("Left connected", &conn_left);
					ImGui::Checkbox("Right connected", &conn_right);
					ImGui::Checkbox("Remote connected", &conn_remote);
					ImGui::Checkbox("XBox connected", &conn_xbox);
					ImGui::Checkbox("VR Object 0 connected", &conn_object0);
					ImGui::Checkbox("VR Object 1 connected", &conn_object1);
					ImGui::Checkbox("VR Object 2 connected", &conn_object2);
					ImGui::Checkbox("VR Object 3 connected", &conn_object3);

					ImGui::End();

					if (conn_object0)
					{
						ImGui::Begin("VR Object 0");
						ovrTrackedDeviceType types[4] = { ovrTrackedDeviceType::ovrTrackedDevice_Object0, ovrTrackedDeviceType::ovrTrackedDevice_Object1, ovrTrackedDeviceType::ovrTrackedDevice_Object2, ovrTrackedDeviceType::ovrTrackedDevice_Object3 };
						ovrPoseStatef poses[4];
						ovr_GetDevicePoses(g_HMD, types, 4, 0, poses);
						//ImGui::LabelText("Tracking", s.c_str());
						ImGui::LabelText("Pos", "%0.2f, %0.2f, %0.2f", poses[0].ThePose.Position.x, poses[0].ThePose.Position.y, poses[0].ThePose.Position.z);
						ImGui::LabelText("Orientation", "%0.2f, %0.2f, %0.2f, %0.2f", poses[0].ThePose.Orientation.w, poses[0].ThePose.Orientation.x, poses[0].ThePose.Orientation.y, poses[0].ThePose.Orientation.z);
						ImGui::LabelText("Vel", "%0.2f, %0.2f, %0.2f", poses[0].LinearVelocity.x, poses[0].LinearVelocity.y, poses[0].LinearVelocity.z);


						ImGui::End();
					}
					if (conn_remote)
					{
						ImGui::Begin("Remote");
						bool remoteLeft = state.remoteButtons & ovrButton_Left;
						bool remoteRight = state.remoteButtons & ovrButton_Right;
						bool remoteUp = state.remoteButtons & ovrButton_Up;
						bool remoteDown = state.remoteButtons & ovrButton_Down;
						bool remoteEnter = state.remoteButtons & ovrButton_Enter;
						bool remoteBack = state.remoteButtons & ovrButton_Back;
						ImGui::Checkbox("Up", &remoteUp);
						ImGui::Checkbox("Down", &remoteDown);
						ImGui::Checkbox("Left", &remoteLeft);
						ImGui::Checkbox("Right", &remoteRight);
						ImGui::Checkbox("Enter", &remoteEnter);
						ImGui::Checkbox("Back", &remoteBack);
						ImGui::End();
					}

					if (conn_left)
					{
						ImGui::Begin("Left Touch");
						ImGui::SliderFloat("Index", &state.touchIndexTrigger[0], 0.0f, 1.0f);
						ImGui::SliderFloat("IndexNDZ", &state.touchIndexTriggerNDZ[0], 0.0f, 1.0f);
						ImGui::SliderFloat("IndexRaw", &state.touchIndexTriggerRaw[0], 0.0f, 1.0f);
						ImGui::SliderFloat("Hand", &state.touchHandTrigger[0], 0.0f, 1.0f);
						ImGui::SliderFloat("HandNDZ", &state.touchHandTriggerNDZ[0], 0.0f, 1.0f);
						ImGui::SliderFloat("HandRaw", &state.touchHandTriggerRaw[0], 0.0f, 1.0f);
						ImGui::SliderFloat("Thumb X", &state.touchThumbStick[0].x, -1.0f, 1.0f);
						ImGui::SliderFloat("Thumb X NDZ", &state.touchThumbStickNDZ[0].x, -1.0f, 1.0f);
						ImGui::SliderFloat("Thumb X Raw", &state.touchThumbStickRaw[0].x, -1.0f, 1.0f);
						ImGui::SliderFloat("Thumb Y", &state.touchThumbStick[0].y, -1.0f, 1.0f);
						ImGui::SliderFloat("Thumb Y NDZ", &state.touchThumbStickNDZ[0].y, -1.0f, 1.0f);
						ImGui::SliderFloat("Thumb Y Raw", &state.touchThumbStickRaw[0].y, -1.0f, 1.0f);
						bool buttonX = state.touchButtons & ovrButton_X;
						bool buttonY = state.touchButtons & ovrButton_Y;
						bool buttonThumb = state.touchButtons & ovrButton_LThumb;
						bool buttonMenu = state.touchButtons & ovrButton_Enter;
						ImGui::Text("Buttons");
						ImGui::Checkbox("X", &buttonX);
						ImGui::Checkbox("Y", &buttonY);
						ImGui::Checkbox("Thumb", &buttonThumb);
						ImGui::Checkbox("Menu", &buttonMenu);
						bool touchX = state.touchTouch & ovrTouch_X;
						bool touchY = state.touchTouch & ovrTouch_Y;
						bool touchThumb = state.touchTouch & ovrTouch_LThumb;
						bool touchPad = state.touchTouch & ovrTouch_LThumbRest;
						bool touchIndex = state.touchTouch & ovrTouch_LIndexTrigger;
						bool touchPoint = state.touchTouch & ovrTouch_LIndexPointing;
						bool touchThumbUp = state.touchTouch & ovrTouch_LThumbUp;
						ImGui::Text("Touches");
						ImGui::Checkbox("X", &touchX);
						ImGui::Checkbox("Y", &touchY);
						ImGui::Checkbox("Thumb", &touchThumb);
						ImGui::Checkbox("Pad", &touchPad);
						ImGui::Checkbox("Index", &touchIndex);
						ImGui::Checkbox("Point", &touchPoint);
						ImGui::Checkbox("Thumbs Up", &touchThumbUp);
						std::string s;
						if (state.trackingState.HandStatusFlags[0] & ovrStatus_OrientationTracked)
						{
							appendstring(s, "Orientation");
						}
						if (state.trackingState.HandStatusFlags[0] & ovrStatus_PositionTracked)
						{
							appendstring(s, "Position");
						}
						ImGui::LabelText("Tracking", s.c_str());
						ImGui::LabelText("Pos", "%0.2f, %0.2f, %0.2f", state.trackingState.HandPoses[0].ThePose.Position.x, state.trackingState.HandPoses[0].ThePose.Position.y, state.trackingState.HandPoses[0].ThePose.Position.z);
						ImGui::LabelText("Orientation", "%0.2f, %0.2f, %0.2f, %0.2f", state.trackingState.HandPoses[0].ThePose.Orientation.w, state.trackingState.HandPoses[0].ThePose.Orientation.x, state.trackingState.HandPoses[0].ThePose.Orientation.y, state.trackingState.HandPoses[0].ThePose.Orientation.z);
						ImGui::LabelText("Vel", "%0.2f, %0.2f, %0.2f", state.trackingState.HandPoses[0].LinearVelocity.x, state.trackingState.HandPoses[0].LinearVelocity.y, state.trackingState.HandPoses[0].LinearVelocity.z);

						ImGui::End();
					}
					if (conn_right)
					{
						ImGui::Begin("Right Touch");
						ImGui::SliderFloat("Index", &state.touchIndexTrigger[1], 0.0f, 1.0f);
						ImGui::SliderFloat("IndexNDZ", &state.touchIndexTriggerNDZ[1], 0.0f, 1.0f);
						ImGui::SliderFloat("IndexRaw", &state.touchIndexTriggerRaw[1], 0.0f, 1.0f);
						ImGui::SliderFloat("Hand", &state.touchHandTrigger[1], 0.0f, 1.0f);
						ImGui::SliderFloat("HandNDZ", &state.touchHandTriggerNDZ[1], 0.0f, 1.0f);
						ImGui::SliderFloat("HandRaw", &state.touchHandTriggerRaw[1], 0.0f, 1.0f);
						ImGui::SliderFloat("Thumb X", &state.touchThumbStick[1].x, -1.0f, 1.0f);
						ImGui::SliderFloat("Thumb X NDZ", &state.touchThumbStickNDZ[1].x, -1.0f, 1.0f);
						ImGui::SliderFloat("Thumb X Raw", &state.touchThumbStickRaw[1].x, -1.0f, 1.0f);
						ImGui::SliderFloat("Thumb Y", &state.touchThumbStick[1].y, -1.0f, 1.0f);
						ImGui::SliderFloat("Thumb Y NDZ", &state.touchThumbStickNDZ[1].y, -1.0f, 1.0f);
						ImGui::SliderFloat("Thumb Y Raw", &state.touchThumbStickRaw[1].y, -1.0f, 1.0f);
						bool buttonA = state.touchButtons & ovrButton_A;
						bool buttonB = state.touchButtons & ovrButton_B;
						bool buttonThumb = state.touchButtons & ovrButton_RThumb;
						bool buttonHome = state.touchButtons & ovrButton_Home;
						ImGui::Text("Buttons");
						ImGui::Checkbox("A", &buttonA);
						ImGui::Checkbox("B", &buttonB);
						ImGui::Checkbox("Thumb", &buttonThumb);
						ImGui::Checkbox("Home", &buttonHome);
						bool touchA = state.touchTouch & ovrTouch_A;
						bool touchB = state.touchTouch & ovrTouch_B;
						bool touchThumb = state.touchTouch & ovrTouch_RThumb;
						bool touchPad = state.touchTouch & ovrTouch_RThumbRest;
						bool touchIndex = state.touchTouch & ovrTouch_RIndexTrigger;
						bool touchPoint = state.touchTouch & ovrTouch_RIndexPointing;
						bool touchThumbUp = state.touchTouch & ovrTouch_RThumbUp;
						ImGui::Text("Touches");
						ImGui::Checkbox("A", &touchA);
						ImGui::Checkbox("B", &touchB);
						ImGui::Checkbox("Thumb", &touchThumb);
						ImGui::Checkbox("Pad", &touchPad);
						ImGui::Checkbox("Index", &touchIndex);
						ImGui::Checkbox("Point", &touchPoint);
						ImGui::Checkbox("Thumbs Up", &touchThumbUp);
						std::string s;
						if (state.trackingState.HandStatusFlags[1] & ovrStatus_OrientationTracked)
						{
							appendstring(s, "Orientation");
						}
						if (state.trackingState.HandStatusFlags[1] & ovrStatus_PositionTracked)
						{
							appendstring(s, "Position");
						}
						ImGui::LabelText("Tracking", s.c_str());
						ImGui::LabelText("Pos", "%0.2f, %0.2f, %0.2f", state.trackingState.HandPoses[1].ThePose.Position.x, state.trackingState.HandPoses[1].ThePose.Position.y, state.trackingState.HandPoses[1].ThePose.Position.z);
						ImGui::LabelText("Orientation", "%0.2f, %0.2f, %0.2f, %0.2f", state.trackingState.HandPoses[1].ThePose.Orientation.w, state.trackingState.HandPoses[1].ThePose.Orientation.x, state.trackingState.HandPoses[1].ThePose.Orientation.y, state.trackingState.HandPoses[1].ThePose.Orientation.z);
						ImGui::LabelText("Vel", "%0.2f, %0.2f, %0.2f", state.trackingState.HandPoses[1].LinearVelocity.x, state.trackingState.HandPoses[1].LinearVelocity.y, state.trackingState.HandPoses[1].LinearVelocity.z);
						ImGui::End();
					}
				}
				{
					ImGui::Begin("Room Layout");
					ImGui::Checkbox("Show Sensors", &showSensors);

					AABB aabb;
					ImVec2 size = ImGui::GetContentRegionMax();
					ImVec2 offset = ImGui::GetWindowPos();
					int outerCount = 0;
					int playCount = 0;
					ovr_GetBoundaryGeometry(g_HMD, ovrBoundaryType::ovrBoundary_Outer, 0, &outerCount);
					ovr_GetBoundaryGeometry(g_HMD, ovrBoundaryType::ovrBoundary_PlayArea, 0, &playCount);

					std::vector<ovrVector3f> outerPoints3d(outerCount);
					std::vector<ovrVector3f> playPoints3d(playCount);

					if (outerCount > 0)
					{
						ovr_GetBoundaryGeometry(g_HMD, ovrBoundaryType::ovrBoundary_Outer, &(outerPoints3d[0]), &outerCount);
						for (int i = 0; i < outerCount; ++i)
						{
							aabb.merge(outerPoints3d[i]);
						}
					}

					if (playCount > 0)
					{
						ovr_GetBoundaryGeometry(g_HMD, ovrBoundaryType::ovrBoundary_PlayArea, &(playPoints3d[0]), &playCount);
						for (int i = 0; i < playCount; ++i)
						{
							aabb.merge(playPoints3d[i]);
						}
					}

					if (showSensors)
					{
						for (int i = 0; i < state.sensorCount; ++i)
						{
							aabb.merge(state.sensorPose[i].LeveledPose.Position);
						}
					}

					aabb.minCorner -= OVR::Vector3f(0.2, 0.2, 0.2);
					aabb.maxCorner += OVR::Vector3f(0.2, 0.2, 0.2);

					std::vector<ImVec2> outerPoints2d(outerCount);
					std::vector<ImVec2> playPoints2d(playCount);

					for (int i = 0; i < outerCount; ++i)
					{
						outerPoints2d[i] = aabb.remap(size, offset, outerPoints3d[i]);
					}
					if (outerCount > 0)
					{
						ImGui::GetWindowDrawList()->AddPolyline(&outerPoints2d[0], outerCount, 0xffffffff, true, 1);
					}

					for (int i = 0; i < playCount; ++i)
					{
						playPoints2d[i] = aabb.remap(size, offset, playPoints3d[i]);
					}
					if (outerCount > 0)
					{
						ImGui::GetWindowDrawList()->AddPolyline(&playPoints2d[0], playCount, 0xffffff00, true, 1);
					}

					ImVec2 pos;
					ImVec2 pos1;
					ImVec2 pos2;
					ImVec2 pos3;
					ImVec2 pos4;

					pos = aabb.remap(size, offset, state.trackingState.HandPoses[0].ThePose.Position);
					ImGui::GetWindowDrawList()->AddCircle(pos, 10, 0xffffffff);
					pos2 = aabb.remap(size, offset, OVR::Vector3f(state.trackingState.HandPoses[0].ThePose.Position) + OVR::Quatf(state.trackingState.HandPoses[0].ThePose.Orientation) * OVR::Vector3f(0.2, 0, 0));
					ImGui::GetWindowDrawList()->AddLine(pos, pos2, 0xff0000ff);
					pos2 = aabb.remap(size, offset, OVR::Vector3f(state.trackingState.HandPoses[0].ThePose.Position) + OVR::Quatf(state.trackingState.HandPoses[0].ThePose.Orientation) * OVR::Vector3f(0, 0.2, 0));
					ImGui::GetWindowDrawList()->AddLine(pos, pos2, 0xff00ff00);
					pos2 = aabb.remap(size, offset, OVR::Vector3f(state.trackingState.HandPoses[0].ThePose.Position) + OVR::Quatf(state.trackingState.HandPoses[0].ThePose.Orientation) * OVR::Vector3f(0, 0, -0.2));
					ImGui::GetWindowDrawList()->AddLine(pos, pos2, 0xffff3030);

					pos = aabb.remap(size, offset, state.trackingState.HandPoses[1].ThePose.Position);
					ImGui::GetWindowDrawList()->AddCircle(pos, 10, 0xffffffff);
					pos2 = aabb.remap(size, offset, OVR::Vector3f(state.trackingState.HandPoses[1].ThePose.Position) + OVR::Quatf(state.trackingState.HandPoses[1].ThePose.Orientation) * OVR::Vector3f(0.2, 0, 0));
					ImGui::GetWindowDrawList()->AddLine(pos, pos2, 0xff0000ff);
					pos2 = aabb.remap(size, offset, OVR::Vector3f(state.trackingState.HandPoses[1].ThePose.Position) + OVR::Quatf(state.trackingState.HandPoses[1].ThePose.Orientation) * OVR::Vector3f(0, 0.2, 0));
					ImGui::GetWindowDrawList()->AddLine(pos, pos2, 0xff00ff00);
					pos2 = aabb.remap(size, offset, OVR::Vector3f(state.trackingState.HandPoses[1].ThePose.Position) + OVR::Quatf(state.trackingState.HandPoses[1].ThePose.Orientation) * OVR::Vector3f(0, 0, -0.2));
					ImGui::GetWindowDrawList()->AddLine(pos, pos2, 0xffff3030);

					pos = aabb.remap(size, offset, state.trackingState.HeadPose.ThePose.Position);
					ImGui::GetWindowDrawList()->AddCircle(pos, 10, 0xff00ffff);
					pos2 = aabb.remap(size, offset, OVR::Vector3f(state.trackingState.HeadPose.ThePose.Position) + OVR::Quatf(state.trackingState.HeadPose.ThePose.Orientation) * OVR::Vector3f(0.2, 0, 0));
					ImGui::GetWindowDrawList()->AddLine(pos, pos2, 0xff0000ff);
					pos2 = aabb.remap(size, offset, OVR::Vector3f(state.trackingState.HeadPose.ThePose.Position) + OVR::Quatf(state.trackingState.HeadPose.ThePose.Orientation) * OVR::Vector3f(0, 0.2, 0));
					ImGui::GetWindowDrawList()->AddLine(pos, pos2, 0xff00ff00);
					pos2 = aabb.remap(size, offset, OVR::Vector3f(state.trackingState.HeadPose.ThePose.Position) + OVR::Quatf(state.trackingState.HeadPose.ThePose.Orientation) * OVR::Vector3f(0, 0, -0.2));
					ImGui::GetWindowDrawList()->AddLine(pos, pos2, 0xffff3030);

					pos = aabb.remap(size, offset, state.trackingState.CalibratedOrigin.Position);
					ImGui::GetWindowDrawList()->AddCircle(pos, 10, 0xff0000ff);
					pos2 = aabb.remap(size, offset, OVR::Vector3f(state.trackingState.CalibratedOrigin.Position) + OVR::Quatf(state.trackingState.CalibratedOrigin.Orientation) * OVR::Vector3f(0.2, 0, 0));
					ImGui::GetWindowDrawList()->AddLine(pos, pos2, 0xff0000ff);
					pos2 = aabb.remap(size, offset, OVR::Vector3f(state.trackingState.CalibratedOrigin.Position) + OVR::Quatf(state.trackingState.CalibratedOrigin.Orientation) * OVR::Vector3f(0, 0.2, 0));
					ImGui::GetWindowDrawList()->AddLine(pos, pos2, 0xff00ff00);
					pos2 = aabb.remap(size, offset, OVR::Vector3f(state.trackingState.CalibratedOrigin.Position) + OVR::Quatf(state.trackingState.CalibratedOrigin.Orientation) * OVR::Vector3f(0, 0, -0.2));
					ImGui::GetWindowDrawList()->AddLine(pos, pos2, 0xffff3030);

					if (showSensors)
					{
						for (int i = 0; i < state.sensorCount; ++i)
						{
							//ovrTrackerDesc desc = ovr_GetTrackerDesc(g_HMD, i);
							//ovrTrackerPose pose = ovr_GetTrackerPose(g_HMD, i);
							float fov = state.sensorDesc[i].FrustumHFovInRadians / 2.0;
							pos = aabb.remap(size, offset, state.sensorPose[i].Pose.Position);
							ImGui::GetWindowDrawList()->AddCircle(pos, 10, 0xffff00ff);
							OVR::Quatf q = state.sensorPose[i].LeveledPose.Orientation;
							OVR::Vector3f dir = q * OVR::Vector3f(0, 0, 1);
							OVR::Vector3f dirPerp(-dir.z, dir.y, dir.x);
							float x = sin(fov);
							float y = cos(fov);
							float scaleNear = state.sensorDesc[i].FrustumNearZInMeters / y;
							float scaleFar = state.sensorDesc[i].FrustumFarZInMeters / y;

							pos1 = aabb.remap(size, offset, OVR::Vector3f(state.sensorPose[i].Pose.Position) + dir * y * scaleNear + dirPerp * -x * scaleNear);
							pos2 = aabb.remap(size, offset, OVR::Vector3f(state.sensorPose[i].Pose.Position) + dir * y * scaleNear + dirPerp * x * scaleNear);
							pos3 = aabb.remap(size, offset, OVR::Vector3f(state.sensorPose[i].Pose.Position) + dir * y * scaleFar + dirPerp * -x * scaleFar);
							pos4 = aabb.remap(size, offset, OVR::Vector3f(state.sensorPose[i].Pose.Position) + dir * y * scaleFar + dirPerp * x * scaleFar);

							ImGui::GetWindowDrawList()->AddQuadFilled(pos1, pos3, pos4, pos2, 0x20ff00ff);
							ImGui::GetWindowDrawList()->AddLine(pos, pos3, 0xffff00ff);
							ImGui::GetWindowDrawList()->AddLine(pos, pos4, 0xffff00ff);
						}
					}
					ImGui::End();
				}
			}
			else
			{
				ImGui::Begin("Error");
				ImGui::Text("Failed to create the session");
				ImGui::End();
			}

			// Rendering
			ImGui::Render();
			g_pd3dDeviceContext->OMSetRenderTargets(1, &g_mainRenderTargetView, NULL);
			g_pd3dDeviceContext->ClearRenderTargetView(g_mainRenderTargetView, (float*)&clear_color);
			ImGui_ImplDX11_RenderDrawData(ImGui::GetDrawData());

			g_pSwapChain->Present(1, 0); // Present with vsync
		}
		else
		{
			Sleep(100);
		}
	}

	ovr_Destroy(g_HMD);

	ImGui_ImplDX11_Shutdown();
	ImGui_ImplWin32_Shutdown();
	ImGui::DestroyContext();

	CleanupDeviceD3D();
	DestroyWindow(hwnd);
	UnregisterClass(_T("Oculus Monitor"), wc.hInstance);

	return 0;
}